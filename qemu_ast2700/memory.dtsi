/*
 * SPDX-License-Identifier: Apache-2.0
 * Copyright (c) 2019 KapaXL (kapa.xl@outlook.com)
 */

/{
	#address-cells = <2>;
	#size-cells = <2>;

	memory@400000000 {
		compatible = "memory";
		device_type = "memory";

		reg = <4 0x00000000 0 0x80000000>;

		rpc-t2r-ring = <4 0x15F10000 0 0x20000>;
		rpc-t2r-shm = <4 0x15F30000 0 0x40000>;
	};

	reserved-memory {
		#address-cells = <2>;
		#size-cells = <2>;
		ranges;

		reserved: resv@400000000 {
			reg = <4 0x00000000 0 0x20000000>;
		};
	};
};
