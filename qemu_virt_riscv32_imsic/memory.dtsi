/*
 * SPDX-License-Identifier: Apache-2.0
 * Copyright (c) 2025 KapaXL (kapa.xl@outlook.com)
 */

/{
	#address-cells = <2>;
	#size-cells = <2>;

	memory@80000000 {
		compatible = "memory";
		device_type = "memory";

		reg = <0 0x80000000 0 0x40000000>;

		rpc-t2r-ring = <0 0x85F10000 0 0x20000>;
		rpc-t2r-shm = <0 0x85F30000 0 0x40000>;
		rpc-r2t-ring = <0 0x85F70000 0 0x20000>;
	};

	reserved-memory {
		#address-cells = <2>;
		#size-cells = <2>;
		ranges;

		tee_reserved: resv@80000000 {
			reg = <0 0x80000000 0 0x6400000>;
		};
	};
};
