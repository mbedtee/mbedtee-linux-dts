/*
 * SPDX-License-Identifier: Apache-2.0
 * Copyright (c) 2025 KapaXL (kapa.xl@outlook.com)
 */

/{
	#address-cells = <2>;
	#size-cells = <2>;

	memory@6000000 {
		compatible = "memory";
		device_type = "memory";

		reg = <0 0x00000000 0 0x80000000>;

		rpc-t2r-ring = <0 0x05F10000 0 0x20000>;
		rpc-t2r-shm = <0 0x05F30000 0 0x40000>;
	};

	reserved-memory {
		#address-cells = <2>;
		#size-cells = <2>;
		ranges;

		reserved: resv@6000000 {
			reg = <0 0x0000000 0 0x6000000>;
		};
	};
};
